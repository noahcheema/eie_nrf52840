## prj.conf
```kconfig
# Copyright (c) 2021 Nordic Semiconductor ASA
# SPDX-License-Identifier: Apache-2.0
#
# This file contains selected Kconfig options for the application.

CONFIG_GPIO=y
CONFIG_PWM=y
CONFIG_SMF=y

CONFIG_SYSTEM_WORKQUEUE_STACK_SIZE=2048
CONFIG_BT=y
CONFIG_BT_PERIPHERAL=y
CONFIG_BT_DEVICE_NAME="Temu Services"
```

## src/main.c
```c
/*
 * main.c
 */

#include <inttypes.h>
#include <stdio.h>
#include <string.h>
#include <zephyr/bluetooth/bluetooth.h>
#include <zephyr/bluetooth/conn.h>
#include <zephyr/bluetooth/gatt.h>
#include <zephyr/bluetooth/hci.h>
#include <zephyr/bluetooth/uuid.h>
#include <zephyr/device.h>
#include <zephyr/devicetree.h>
#include <zephyr/drivers/display.h>
#include <zephyr/drivers/gpio.h>
#include <zephyr/kernel.h>
#include <zephyr/settings/settings.h>
#include <zephyr/sys/printk.h>
#include "BTN.h"
#include "LED.h"

#define SLEEP_MS 1

#define BLE_CUSTOM_CHARACTERISTIC_MAX_DATA_LENGTH 20

#define BLE_CUSTOM_SERVICE_UUID \
  BT_UUID_128_ENCODE(0x12345678, 0x1234, 0x5678, 0x1234, 0x56789abcdef0)
#define BLE_CUSTOM_CHARACTERISTIC_UUID \
  BT_UUID_128_ENCODE(0x12345678, 0x1234, 0x5678, 0x1234, 0x56789abcdef1)


static const struct bt_data ble_advertising_data[]={
  BT_DATA_BYTES(BT_DATA_FLAGS, (BT_LE_AD_GENERAL | BT_LE_AD_NO_BREDR)),
  BT_DATA(BT_DATA_NAME_COMPLETE, CONFIG_BT_DEVICE_NAME, sizeof(CONFIG_BT_DEVICE_NAME)),
};

static uint8_t ble_custom_characteristic_user_data[20] = {};

static ssize_t ble_custom_characteristic_read_cb(struct bt_conn* conn, const struct bt_gatt_attr* attr, void* buf, uint16_t len, uint16_t offset){
  const char* value = attr->user_data;
  return bt_gatt_attr_read(conn, attr, buf, len, offset, value, strlen(value));
}

static ssize_t ble_custom_characteristic_write_cb(struct bt_conn* conn, const struct bt_gatt_attr* attr, const void* buf, uint16_t len, uint16_t offset, uint8_t flags){
  uint8_t* value_ptr = attr->user_data;

  if(offset + len > BLE_CUSTOM_CHARACTERISTIC_MAX_DATA_LENGTH){
    return BT_GATT_ERR(BT_ATT_ERR_INVALID_OFFSET);
  }

  memcpy(value_ptr + offset, buf, len);
  value_ptr[offset + len] = 0;

  return len;
}

static const struct bt_uuid_128 ble_custom_service_uuid = BT_UUID_INIT_128(BLE_CUSTOM_SERVICE_UUID);
static const struct bt_uuid_128 ble_custom_characteristic_uuid = BT_UUID_INIT_128(BLE_CUSTOM_CHARACTERISTIC_UUID);

BT_GATT_SERVICE_DEFINE(
  ble_custom_service,
  BT_GATT_PRIMARY_SERVICE(&ble_custom_service_uuid),

  BT_GATT_CHARACTERISTIC(
    &ble_custom_characteristic_uuid.uuid,
    BT_GATT_CHRC_READ | BT_GATT_CHRC_WRITE,
    BT_GATT_PERM_READ | BT_GATT_PERM_WRITE,
    ble_custom_characteristic_read_cb,
    ble_custom_characteristic_write_cb,
    ble_custom_characteristic_user_data
  )

);




int main(void) {

  int bluetooth = bt_enable(NULL);
  if(bluetooth){
    printk("Bluetooth not werking.\n");
  }
  else{
    printk("Bluetooth initialized\n");
  }

  bluetooth = bt_le_adv_start(BT_LE_ADV_CONN_FAST_1, ble_advertising_data, ARRAY_SIZE(ble_advertising_data), NULL, 0);


  if(0 > BTN_init()) {
    return 0;
  }
  if (0 > LED_init()) {
    return 0;
  }

  if(bluetooth){
    printk("Advertising Failed\n");
    return 0;
  }

  while(1) {
    k_msleep(SLEEP_MS);
  }
	return 0;
}
```

## src/my_state_machine.c
```c
/*
* State Machine File
*/

#include <zephyr/smf.h>


#include "LED.h"
#include "BTN.h"
#include "my_state_machine.h"

// USE PWM

/*
Function Prototypes
*/

int press();
void all_LED(int state);
void cleararray();

static enum smf_state_result firstchar_run(void* o);
static enum smf_state_result strbuild_run(void* o);
static enum smf_state_result submission_run(void* o);
static enum smf_state_result standby_run(void* o);

static void firstchar_entry(void* o);
static void strbuild_entry(void* o);
static void submission_entry(void* o);
static void standby_entry(void* o);

/*
Typedefs
*/

enum program_states{
    FIRSTCHAR,
    STRBUILD,
    SUBMISSION,
    STANDBY
};

typedef struct {
    struct smf_ctx ctx;

    uint16_t count;

    int btn;

    uint8_t bit_index;

    uint8_t character;

    int string[128];
    
    uint8_t len;

    int prevstate;

    uint8_t current_duty_cycle;

} machine_state_object_t;

/*
Local Variables
*/

static const struct smf_state machine_states[] = {
    [FIRSTCHAR] = SMF_CREATE_STATE(firstchar_entry, firstchar_run, NULL, NULL, NULL),
    [STRBUILD] = SMF_CREATE_STATE(strbuild_entry, strbuild_run, NULL, NULL, NULL),
    [SUBMISSION] = SMF_CREATE_STATE(submission_entry, submission_run, NULL, NULL, NULL),
    [STANDBY] = SMF_CREATE_STATE(standby_entry, standby_run, NULL, NULL, NULL)
};

static machine_state_object_t machine_state_object; 

/*
Function Definitions
*/

int press(){
    if(BTN_check_clear_pressed(BTN0)) return 1;
    if(BTN_check_clear_pressed(BTN1)) return 2;
    if(BTN_check_clear_pressed(BTN2)) return 3;
    if(BTN_check_clear_pressed(BTN3)) return 4;
    return -1;
}

void cleararray(void *p, size_t len){
    unsigned char *b = p;
    for(size_t i = 0; i < len; i++){
        b[i] = 0;
    }
}

void all_LED(int state){
    for(int i = 0; i < 4; i++){
        LED_set(i, state);
    }
}

int held(){
    static int time = 0;

    if(BTN_is_pressed(BTN0) && BTN_is_pressed(BTN1)){
        if(time ==0)
            time = k_uptime_get();
    if(k_uptime_get() - time >= 3000)
        return 1;
    }

    else time = 0; 

    return 0;
}

void state_machine_init(){
    machine_state_object.count = 0;
    machine_state_object.btn = -1;
    machine_state_object.bit_index = 0;
    machine_state_object.character = 0;

    smf_set_initial(SMF_CTX(&machine_state_object), &machine_states[FIRSTCHAR]);
}

int state_machine_run(){
    return smf_run_state(SMF_CTX(&machine_state_object));
}

static void firstchar_entry(void* o){
    machine_state_object.count = 0;
    machine_state_object.btn = -1;
    machine_state_object.bit_index = 0;
    machine_state_object.character = 0;
    cleararray(machine_state_object.string, sizeof(machine_state_object.string));
    all_LED(LED_OFF);
    LED_set(LED3, LED_ON);
}

static enum smf_state_result firstchar_run(void* o){
    if(machine_state_object.count == 1000){
        LED_toggle(LED3);
        machine_state_object.count = 0;
    }

    if(machine_state_object.btn == 1)
        machine_state_object.bit_index++;
    
    else if(machine_state_object.btn == 2){
        machine_state_object.character |= (1 << (7 - machine_state_object.bit_index));
        machine_state_object.bit_index++;
    }

    else if(machine_state_object.btn == 3){
        printk("Button 3 pressed, clearing first character entry.\n");
        machine_state_object.bit_index = 0;
        machine_state_object.character = 0;
    }

    else if(machine_state_object.btn == 4){
        if(machine_state_object.bit_index != 0){
            printk("Invalid ASCII codes detected, restarting program\n");
            smf_set_state(SMF_CTX(&machine_state_object), &machine_states[FIRSTCHAR]);
        }
        printk("Button 4 Pressed, Entering string build state\n");
        smf_set_state(SMF_CTX(&machine_state_object), &machine_states[STRBUILD]);
    }

    else if(held() == 1){
        printk("Entering Standby State...\n");
        machine_state_object.prevstate = 1;
        smf_set_state(SMF_CTX(&machine_state_object), &machine_states[STANDBY]);
    }
    
    if(machine_state_object.bit_index == 8){
        machine_state_object.string[machine_state_object.len++] = (char) machine_state_object.character;
        machine_state_object.bit_index = 0;
        machine_state_object.character = 0;
    }

    machine_state_object.count++;
    machine_state_object.btn = press();
    return SMF_EVENT_HANDLED;
}

static void strbuild_entry(void* o){
    machine_state_object.count = 0;
    machine_state_object.btn = -1;
    machine_state_object.bit_index = 0;
    machine_state_object.character = 0;
    all_LED(LED_OFF);
}

static enum smf_state_result strbuild_run(void* o){
    if(machine_state_object.count == 250){
        LED_toggle(LED3);
        machine_state_object.count = 0;
    }
    
    if(machine_state_object.btn == 1)
        machine_state_object.bit_index++;
    
    else if(machine_state_object.btn == 2){
        machine_state_object.character |= (1 << (7 - machine_state_object.bit_index));
        machine_state_object.bit_index++;
    }

    else if(machine_state_object.btn == 3){
        printk("Clearing current entry and prior entrys...\nReturning to initial entry state.\n");
        machine_state_object.bit_index = 0;
        machine_state_object.character = 0;
        cleararray(machine_state_object.string, sizeof(machine_state_object.string));
        machine_state_object.len = 0; 
        smf_set_state(SMF_CTX(&machine_state_object), &machine_states[FIRSTCHAR]);
    }

    else if(machine_state_object.btn == 4){
        
        if(machine_state_object.bit_index != 0){
            printk("Invalid ASCII codes detected, restarting program\n");
            smf_set_state(SMF_CTX(&machine_state_object), &machine_states[FIRSTCHAR]);
        }

        printk("Entering Submission State...\nButton 4 to print string. Button 3 to restart.\n");
        machine_state_object.string[machine_state_object.len] = '\0';
        smf_set_state(SMF_CTX(&machine_state_object), &machine_states[SUBMISSION]);
    }

    else if(held() == 1){
        printk("Entering Standby State...\n");
        machine_state_object.prevstate = 2;
        smf_set_state(SMF_CTX(&machine_state_object), &machine_states[STANDBY]);
    }

    if(machine_state_object.bit_index == 8){
        machine_state_object.string[machine_state_object.len++] = (char) machine_state_object.character;
        machine_state_object.bit_index = 0;
        machine_state_object.character = 0;
    }


    machine_state_object.count++;
    machine_state_object.btn = press();
    return SMF_EVENT_HANDLED;
}

static void submission_entry(void* o){
    machine_state_object.count = 0;
    machine_state_object.btn = -1;
    machine_state_object.bit_index = 0;
    machine_state_object.character = 0;
    all_LED(LED_OFF);
}

static enum smf_state_result submission_run(void* o){
    if(machine_state_object.count == 63){
        LED_toggle(LED3);
        machine_state_object.count = 0;
    }

    if(machine_state_object.btn == 3){
        printk("Clearing all entries...\n Returning to first character entry state\n");
        smf_set_state(SMF_CTX(&machine_state_object), &machine_states[FIRSTCHAR]);
    }

    else if(machine_state_object.btn == 4){
        printk("Printing string to serial monitor...\n");
        for(int i = 0; machine_state_object.string[i] != '\0'; i++)
            printk("%d", machine_state_object.string[i]);
        printk("\nRestarting program(Returning to first character entry state)\n");
        smf_set_state(SMF_CTX(&machine_state_object), &machine_states[FIRSTCHAR]);
    }

    else if(held() == 1){
        printk("Entering Standby State...\n");
        machine_state_object.prevstate = 3;
        smf_set_state(SMF_CTX(&machine_state_object), &machine_states[STANDBY]);
    }
        
    machine_state_object.count++;
    machine_state_object.btn = press();
    
    return SMF_EVENT_HANDLED;
}

static void standby_entry(void* o){
    machine_state_object.count = 0;
    machine_state_object.btn = -1;
    machine_state_object.bit_index = 0;
    machine_state_object.character = 0;
    machine_state_object.current_duty_cycle = 0;
    all_LED(LED_OFF);
}

static enum smf_state_result standby_run(void* o){
  
    if(machine_state_object.current_duty_cycle >= 100){
        for(int i = 0; i < 100; i++){
            machine_state_object.current_duty_cycle = machine_state_object.current_duty_cycle - 1; 
            k_msleep(10);
            LED_pwm(LED0, machine_state_object.current_duty_cycle); LED_pwm(LED1, machine_state_object.current_duty_cycle); LED_pwm(LED2, machine_state_object.current_duty_cycle); LED_pwm(LED3, machine_state_object.current_duty_cycle);
        }
    }

    else{
        for(int j = 0; j < 100; j++){
            machine_state_object.current_duty_cycle = machine_state_object.current_duty_cycle + 1;
            k_msleep(10);
            LED_pwm(LED0, machine_state_object.current_duty_cycle); LED_pwm(LED1, machine_state_object.current_duty_cycle); LED_pwm(LED2, machine_state_object.current_duty_cycle); LED_pwm(LED3, machine_state_object.current_duty_cycle);
        }
    }

    
    if(machine_state_object.btn == 3 || machine_state_object.btn == 4){
        if(machine_state_object.prevstate == 1){
            printk("Returning to first character entry state\n");
            smf_set_state(SMF_CTX(&machine_state_object), &machine_states[FIRSTCHAR]);
        }

        else if(machine_state_object.prevstate == 2){
            printk("Returning to string build state\n");
            smf_set_state(SMF_CTX(&machine_state_object), &machine_states[STRBUILD]);
        }

        else if(machine_state_object.prevstate == 3){
            printk("Returning to submission state\n");
            smf_set_state(SMF_CTX(&machine_state_object), &machine_states[SUBMISSION]);
        }
    }
    
    machine_state_object.btn=press();
    
    return SMF_EVENT_HANDLED;
}
```

## src/my_state_machine.h
```c
/*
* my state machine header file
*/

#ifndef MY_STATE_MACHINE_H
#define MY_STATE_MACHINE_H

void state_machine_init();

int state_machine_run();

#endif
```
